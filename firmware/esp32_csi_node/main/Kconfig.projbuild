## firmware/esp32_csi_node/main/Kconfig.projbuild
```kconfig
menu "WiFi Sensing CSI Node"

    config CSI_WIFI_SSID
        string "AP SSID"
        default "wifi-sensing"
        help
            Must match the Raspberry Pi hostapd SSID.

    config CSI_WIFI_PASSWORD
        string "AP password"
        default "wifisense123"
        help
            WPA2-PSK passphrase for the Pi AP.

    config CSI_NODE_ID
        int "Node ID"
        range 0 255
        default 1
        help
            Unique id written into every CSI uplink frame.

    config CSI_COLLECTOR_IP
        string "Collector IP (Pi)"
        default "192.168.4.1"
        help
            Raspberry Pi AP address receiving CSI UDP frames.

    config CSI_COLLECTOR_PORT
        int "CSI uplink UDP port"
        range 1 65535
        default 5006

    config CSI_PROBE_PORT
        int "Probe listen UDP port"
        range 1 65535
        default 5005
        help
            Port the Pi probe sender targets. Opening a socket here
            ensures UDP probes are delivered to this station.

    config CSI_CONTROL_PORT
        int "SCHED control UDP port"
        range 1 65535
        default 5007
        help
            Port for Pi orchestrator SYNC / SLOT_BEGIN packets.

    config CSI_HELLO_PORT
        int "HELLO announce UDP port (ESP → Pi)"
        range 1 65535
        default 5008
        help
            Port where this node announces node_id + MAC + IP to the Pi.

    config CSI_MAX_RATE_HZ
        int "Max CSI capture rate (Hz)"
        range 1 200
        default 80
        help
            Drop excess CSI callbacks to keep Wi-Fi/UDP stable.

    config CSI_MESH_TDMA
        bool "Mesh TDMA schedule follower"
        default y
        help
            Follow Pi SCHED packets: defer CSI uplink until REPORT slots,
            transmit mesh probes when scheduled, whitelist peer MACs.

    config CSI_FILTER_BSSID
        bool "Filter CSI to associated AP BSSID (legacy)"
        default n
        depends on !CSI_MESH_TDMA
        help
            Only queue CSI frames whose transmitter MAC matches the AP.
            Ignored when mesh TDMA is enabled (whitelist used instead).

endmenu
```

## firmware/esp32_csi_node/sdkconfig.defaults
```kconfig
# Target: classic ESP32
CONFIG_IDF_TARGET_ESP32=y

# Wi-Fi CSI
CONFIG_ESP_WIFI_CSI_ENABLED=y

# FreeRTOS
CONFIG_FREERTOS_HZ=1000

# Logging
CONFIG_LOG_DEFAULT_LEVEL_INFO=y

# Project defaults (can override in menuconfig)
CONFIG_CSI_WIFI_SSID="wifi-sensing"
CONFIG_CSI_WIFI_PASSWORD="wifisense123"
CONFIG_CSI_NODE_ID=1
CONFIG_CSI_COLLECTOR_IP="192.168.4.1"
CONFIG_CSI_COLLECTOR_PORT=5006
CONFIG_CSI_PROBE_PORT=5005
CONFIG_CSI_MAX_RATE_HZ=80
CONFIG_CSI_FILTER_BSSID=y
```
